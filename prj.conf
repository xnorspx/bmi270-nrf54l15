## CMakeLists.txt
```
cmake_minimum_required(VERSION 3.20.0)

find_package(Zephyr REQUIRED HINTS $ENV{ZEPHYR_BASE})
project(bmi270_nrf54l15)

target_sources(app PRIVATE
    src/main.c
    src/bmi270.c
    src/ble_stream.c
)

target_include_directories(app PRIVATE src)
```

## prj.conf
```kconfig
# BMI270 IMU reader on XIAO nRF54L15

CONFIG_I2C=y
CONFIG_GPIO=y

CONFIG_SERIAL=y
CONFIG_CONSOLE=y
CONFIG_UART_CONSOLE=y
CONFIG_PRINTK=y

# the shell would interleave its prompt with the CSV stream, so the app does
# its own line-based command parsing on the console UART instead
CONFIG_SHELL=n

CONFIG_LOG=n
CONFIG_MAIN_STACK_SIZE=4096

# this board's default is single-threaded, which compiles k_sem out entirely
# (undefined z_impl_k_sem_take / give / reset at link time)
CONFIG_MULTITHREADING=y

# This Zephyr revision declares parameterised (shared) interrupts on nRF54L15,
# and gen_isr_tables.py refuses to build without the software ISR table:
#   "Regular Interrupt 261 declared with parameter ... but no SW ISR_TABLE"
CONFIG_GEN_SW_ISR_TABLE=y

# also build without sysbuild, there is no immutable bootloader or TF-M here

# ------------------------------------------------------------------ Bluetooth
CONFIG_BT=y
CONFIG_BT_PERIPHERAL=y
CONFIG_BT_DEVICE_NAME="KneeChe IMU"

# 247-byte MTU + data length extension: 14 samples per notification
CONFIG_BT_BUF_ACL_RX_SIZE=251
CONFIG_BT_BUF_ACL_TX_SIZE=251
CONFIG_BT_BUF_ACL_TX_COUNT=10
CONFIG_BT_L2CAP_TX_MTU=247
CONFIG_BT_L2CAP_TX_BUF_COUNT=10
CONFIG_BT_AUTO_DATA_LEN_UPDATE=y
CONFIG_BT_USER_DATA_LEN_UPDATE=y
CONFIG_BT_ATT_TX_COUNT=4
CONFIG_BT_RX_STACK_SIZE=2048

# must be greater than BT_BUF_ACL_TX_COUNT
CONFIG_BT_BUF_EVT_RX_COUNT=24
CONFIG_BT_BUF_EVT_DISCARDABLE_COUNT=8
```

## app.overlay
```dts
/*
 * Board overlay for the XIAO nRF54L15.
 *
 * The board file already routes i2c22 to P1.10 / P1.11 (D4 / D5); this overlay
 * only turns the bus on at 400 kHz.
 *
 * The BMI270 INT line (D0 = P1.04) is not declared here: a devicetree node
 * without a compatible does not get phandle-array GPIO macros generated, so
 * main.c builds the gpio_dt_spec for it directly instead.
 */

&i2c22 {
	status = "okay";
	clock-frequency = <400000>;
};
```

## src/main.c
```c
/*
 * BMI270 IMU reader for Seeed XIAO nRF54L15 (Zephyr / NCS).
 *
 * Wiring:
 *   BMI270 SDA -> D4  (P1.10, I2C22)
 *   BMI270 SCL -> D5  (P1.11, I2C22)
 *   BMI270 INT -> D1  (P1.05)
 *   BMI270 VDD -> 3V3, GND -> GND, SDO -> GND (address 0x68)
 *
 * Console comes out of the on-board SAMD11 USB bridge, so the same USB-C cable
 * that flashes the board also shows this output.
 *
 * Commands (newline terminated):
 *   S,<hz>  set poll rate 1..1600      ?  status
 *   I       registers                  C  I2C scan
 *   H       toggle CSV header          Z  pause / resume
 *   R       re-init sensor
 *
 * Output: us,ax_mg,ay_mg,az_mg,gx_mdps,gy_mdps,gz_mdps
 */

#include <errno.h>
#include <stdlib.h>
#include <strings.h>

#include <zephyr/kernel.h>
#include <zephyr/device.h>
#include <zephyr/drivers/gpio.h>
#include <zephyr/drivers/uart.h>
#include <zephyr/sys/printk.h>

#include "bmi270.h"
#include "ble_stream.h"

#define DEFAULT_POLL_HZ 100

/* ------------------------------------------------------------- hardware */

static const struct bmi270_cfg imu = {
	.i2c  = DEVICE_DT_GET(DT_NODELABEL(i2c22)),
	.addr = BMI270_ADDR_DEFAULT,
};

/* D1 = P1.05. Built by hand rather than through GPIO_DT_SPEC_GET: a bare
 * devicetree node without a compatible gets no gpio macros generated, so the
 * phandle-array would not be typed as a GPIO spec.
 *
 * INT must live on GPIO0 (D11, D12) or GPIO1 (D0..D5): GPIO2 (D6..D10,
 * D13..D15) has no gpiote-instance in this SoC, so the Zephyr GPIO driver
 * cannot configure an edge interrupt on it. */
static const struct gpio_dt_spec imu_int = {
	.port     = DEVICE_DT_GET(DT_NODELABEL(gpio1)),
	.pin      = 5,
	.dt_flags = GPIO_ACTIVE_HIGH,
};

static const struct device *const console = DEVICE_DT_GET(DT_CHOSEN(zephyr_console));

/* ---------------------------------------------------------------- state */

K_SEM_DEFINE(int_sem, 0, 1);

static struct gpio_callback int_cb_data;
static volatile uint32_t int_count;

static uint16_t poll_hz    = DEFAULT_POLL_HZ;
static uint32_t last_read_us;
static uint32_t last_sample_cnt;
static uint32_t last_int_ms;

static bool console_stream = false;   /* debug: also print CSV to the console */
static bool header     = true;
static bool sensor_ok;
static bool int_alive  = true;
static bool int_warned;

/* ------------------------------------------------------------- output */

static inline uint32_t us_now(void)
{
	return k_cyc_to_us_floor32(k_cycle_get_32());
}

static void emit_sample(const int16_t d[6])
{
	/* 8 g   -> 4096 LSB/g   -> mg   = raw * 1000 / 4096  = raw * 125 / 512
	 * 500 dps -> 65.536 LSB/dps -> mdps = raw * 15625 / 1024
	 * Integer only: printk has no float support by default. */
	long ax = (long)d[0] * 125 / 512;
	long ay = (long)d[1] * 125 / 512;
	long az = (long)d[2] * 125 / 512;
	long gx = (long)d[3] * 15625 / 1024;
	long gy = (long)d[4] * 15625 / 1024;
	long gz = (long)d[5] * 15625 / 1024;

	printk("%u,%ld,%ld,%ld,%ld,%ld,%ld\n",
	       (unsigned int)us_now(), ax, ay, az, gx, gy, gz);
}

static void print_header(void)
{
	printk("us,ax_mg,ay_mg,az_mg,gx_mdps,gy_mdps,gz_mdps\n");
}

/* ----------------------------------------------------------- interrupt */

static void imu_int_handler(const struct device *port,
			    struct gpio_callback *cb, gpio_port_pins_t pins)
{
	ARG_UNUSED(port);
	ARG_UNUSED(cb);
	ARG_UNUSED(pins);

	int_count = int_count + 1;
	k_sem_give(&int_sem);
}

/* ---------------------------------------------------------- commands */

static void print_status(void)
{
	printk("# sensor: %s\n", sensor_ok ? "initialised" : "NOT initialised - send R");
	printk("# poll=%u Hz  odr=%u Hz  accel=+-8g  gyro=+-500dps\n",
	       poll_hz, bmi270_effective_odr(poll_hz));
	printk("# ble: %s%s  streaming=%s  dropped=%u  ring=%u\n",
	       ble_stream_connected() ? "connected" : "advertising",
	       ble_stream_subscribed() ? "/subscribed" : "",
	       ble_stream_streaming() ? "on" : "off",
	       (unsigned int)ble_stream_dropped(), ble_stream_ring_used());
	printk("# int=%s (%u edges)  console_csv=%s\n",
	       sensor_ok ? (int_alive ? "working" : "timer fallback") : "n/a",
	       (unsigned int)int_count, console_stream ? "on" : "off");
	printk("# commands: START | STOP | S,<hz> | ? | I | C | R | L\n");
}

static void print_registers(void)
{
	uint8_t id = 0, st = 0, acc = 0, gyr = 0, pwr = 0;

	bmi270_read_reg(&imu, 0x00, &id);
	bmi270_read_reg(&imu, 0x21, &st);
	bmi270_read_reg(&imu, 0x40, &acc);
	bmi270_read_reg(&imu, 0x42, &gyr);
	bmi270_read_reg(&imu, 0x7D, &pwr);
	printk("# chip=0x%02X internal=0x%02X acc_conf=0x%02X gyr_conf=0x%02X pwr=0x%02X\n",
	       id, st, acc, gyr, pwr);
}

static void do_init(void)
{
	sensor_ok = (bmi270_init(&imu) == 0);
	if (!sensor_ok) {
		printk("# init FAILED - fix wiring, then send R\n");
		return;
	}

	bmi270_set_rate(&imu, poll_hz);

	/* forget any INT history from before the re-init */
	int_count      = 0;
	last_sample_cnt = 0;
	last_read_us   = us_now();
	last_int_ms    = k_uptime_get();
	int_alive      = true;
	int_warned     = false;
	k_sem_reset(&int_sem);

	printk("# re-init done, poll=%u Hz odr=%u Hz\n",
	       poll_hz, bmi270_effective_odr(poll_hz));
	if (header) {
		print_header();
	}
}

static void run_command(char *cmd)
{
	while (*cmd == ' ') {
		cmd++;
	}
	if (*cmd == '\0') {
		return;
	}

	/* multi-character commands first: both start with 'S', which is also the
	 * single-character "set rate" command */
	if (strncasecmp(cmd, "START", 5) == 0) {
		ble_stream_set_streaming(true);
		printk("# START - streaming samples over BLE\n");
		return;
	}
	if (strncasecmp(cmd, "STOP", 4) == 0) {
		ble_stream_set_streaming(false);
		printk("# STOP - streaming paused, ring=%u\n", ble_stream_ring_used());
		return;
	}

	switch (*cmd) {
	case '?':
	case 'P':
		print_status();
		break;

	case 'I':
		print_registers();
		break;

	case 'C':
		bmi270_scan(&imu);
		break;

	case 'H':
		header = !header;
		printk("# header %s\n", header ? "on" : "off");
		if (header) {
			print_header();
		}
		break;

	case 'L':
		console_stream = !console_stream;
		printk("# console csv %s\n", console_stream ? "on" : "off");
		break;

	case 'R':
		do_init();
		break;

	case 'S': {
		char *p = cmd + 1;

		while (*p == ' ' || *p == ',') {
			p++;
		}
		if (*p == '\0') {
			printk("# usage: S,<hz>\n");
			break;
		}

		long hz = strtol(p, NULL, 10);

		if (hz < 1 || hz > 1600) {
			printk("# ERR: rate must be 1..1600\n");
			break;
		}
		if (!sensor_ok) {
			printk("# ERR: sensor not initialised - send R first\n");
			break;
		}
		if (bmi270_set_rate(&imu, (uint16_t)hz) < 0) {
			printk("# ERR: I2C write failed\n");
			break;
		}
		poll_hz = (uint16_t)hz;
		printk("# poll=%u Hz, odr=%u Hz\n",
		       poll_hz, bmi270_effective_odr(poll_hz));
		break;
	}

	default:
		printk("# unknown command, try ?\n");
		break;
	}
}

static void handle_console(void)
{
	static char buf[32];
	static size_t len;
	uint8_t c;

	while (uart_poll_in(console, &c) == 0) {
		if (c == '\r') {
			continue;
		}
		if (c == '\n') {
			buf[len] = '\0';
			len = 0;
			run_command(buf);
		} else if (len < sizeof(buf) - 1) {
			buf[len++] = (char)c;
		}
	}
}

/* --------------------------------------------------------------- main */

int main(void)
{
	printk("\n# BMI270 reader - XIAO nRF54L15\n");

	if (!device_is_ready(imu.i2c)) {
		printk("# ERR: i2c22 not ready\n");
		return 0;
	}
	if (!gpio_is_ready_dt(&imu_int)) {
		printk("# ERR: INT gpio not ready\n");
		return 0;
	}

	gpio_pin_configure_dt(&imu_int, GPIO_INPUT);
	gpio_init_callback(&int_cb_data, imu_int_handler, BIT(imu_int.pin));
	gpio_add_callback(imu_int.port, &int_cb_data);
	gpio_pin_interrupt_configure_dt(&imu_int, GPIO_INT_EDGE_TO_ACTIVE);

	do_init();
	(void)ble_stream_start();

	while (1) {
		char bcmd[BLE_CMD_MAX];

		while (ble_stream_pop_command(bcmd, sizeof(bcmd))) {
			run_command(bcmd);
		}

		handle_console();

		if (!sensor_ok) {
			k_msleep(50);
			continue;
		}

		/* INT watchdog: no edge for 1 s means the pin is not wired, so fall
		 * back to rate-limiter polling instead of stalling forever. */
		if (int_alive && (k_uptime_get() - last_int_ms) > 1000) {
			int_alive  = false;
			if (!int_warned) {
				int_warned = true;
				printk("# WARN: no INT edge - polling on timer, check D0\n");
			}
		}

		uint32_t now    = us_now();
		uint32_t period = 1000000u / poll_hz;
		uint32_t since  = now - last_read_us;

		if (since < period) {
			/* sleep until the rate limiter expires; an INT edge wakes us early */
			(void)k_sem_take(&int_sem, K_USEC(period - since));
			continue;
		}

		bool fresh = int_alive ? (int_count != last_sample_cnt) : true;

		if (!fresh) {
			(void)k_sem_take(&int_sem, K_USEC(period));
			continue;
		}

		if (int_count != last_sample_cnt) {
			last_int_ms = k_uptime_get();
			if (!int_alive) {
				int_alive = true;
				printk("# INT recovered\n");
			}
		}
		last_sample_cnt = int_count;

		if (ble_stream_streaming() || console_stream) {
			int16_t d[6];

			if (bmi270_read_sample(&imu, d) == 0) {
				struct imu_sample s = {
					.t_us = us_now(),
					.a = { d[0], d[1], d[2] },
					.g = { d[3], d[4], d[5] },
				};

				ble_stream_push(&s);
				if (console_stream) {
					emit_sample(d);
				}
			}
		}

		last_read_us += period;
		if ((us_now() - last_read_us) >= period) {
			last_read_us = us_now();
		}
	}

	return 0;
}
```

## src/ble_stream.c
```c
/*
 * BLE data pipe - implementation.
 */

#include "ble_stream.h"

#include <string.h>

#include <zephyr/kernel.h>
#include <zephyr/sys/printk.h>
#include <zephyr/bluetooth/bluetooth.h>
#include <zephyr/bluetooth/conn.h>
#include <zephyr/bluetooth/gatt.h>
#include <zephyr/bluetooth/uuid.h>

/* ------------------------------------------------------------------ UUIDs */

#define BT_UUID_IMU_SVC_VAL \
	BT_UUID_128_ENCODE(0x6e400001, 0xb5a3, 0xf393, 0xe0a9, 0xe50e24dcca9e)
#define BT_UUID_IMU_RX_VAL \
	BT_UUID_128_ENCODE(0x6e400002, 0xb5a3, 0xf393, 0xe0a9, 0xe50e24dcca9e)
#define BT_UUID_IMU_TX_VAL \
	BT_UUID_128_ENCODE(0x6e400003, 0xb5a3, 0xf393, 0xe0a9, 0xe50e24dcca9e)

static struct bt_uuid_128 uuid_svc = BT_UUID_INIT_128(BT_UUID_IMU_SVC_VAL);
static struct bt_uuid_128 uuid_rx  = BT_UUID_INIT_128(BT_UUID_IMU_RX_VAL);
static struct bt_uuid_128 uuid_tx  = BT_UUID_INIT_128(BT_UUID_IMU_TX_VAL);

/* ------------------------------------------------------------- ring buffer */

#define RING_SAMPLES 2048

/* how long to wait for a second sample before sending a lone one */
#define BATCH_WAIT_US 8000

static struct imu_sample ring[RING_SAMPLES];
static uint32_t ring_head;   /* advanced by the sampler thread */
static uint32_t ring_tail;   /* advanced by the BLE sender thread */
static uint32_t drop_count;
static K_MUTEX_DEFINE(ring_lock);

/* ---------------------------------------------------------- command queue */

#define CMD_MAX 48
#define CMD_DEPTH 4

K_MSGQ_DEFINE(cmd_q, CMD_MAX, CMD_DEPTH, 4);

/* -------------------------------------------------------------- BT state */

static struct bt_conn *current_conn;
static bool subscribed;
static volatile bool streaming;

static K_SEM_DEFINE(adv_restart_sem, 0, 1);

/* TX value attribute is attrs[4]:
 *   [0] primary service, [1] RX declaration, [2] RX value,
 *   [3] TX declaration, [4] TX value, [5] CCC
 */
#define TX_ATTR_INDEX 4

static void ccc_changed(const struct bt_gatt_attr *attr, uint16_t value)
{
	ARG_UNUSED(attr);
	subscribed = (value == BT_GATT_CCC_NOTIFY);

	/* Stream as soon as somebody is listening. Recording is a host-side
	 * decision; the device just keeps the pipe full so the panel can show
	 * live data before the user presses record. */
	streaming = subscribed;

	printk("# BLE %s\n", subscribed ? "subscribed, streaming" : "unsubscribed, idle");
}

static ssize_t on_rx_write(struct bt_conn *conn, const struct bt_gatt_attr *attr,
			   const void *buf, uint16_t len, uint16_t offset,
			   uint8_t flags)
{
	ARG_UNUSED(conn);
	ARG_UNUSED(attr);
	ARG_UNUSED(offset);
	ARG_UNUSED(flags);

	if (len == 0 || len >= CMD_MAX) {
		return len;
	}

	char cmd[CMD_MAX];

	memcpy(cmd, buf, len);
	cmd[len] = '\0';

	/* strip trailing CR/LF so the main-loop parser sees a bare command */
	while (len > 0 && (cmd[len - 1] == '\n' || cmd[len - 1] == '\r')) {
		cmd[--len] = '\0';
	}
	if (len == 0) {
		return len + 1;
	}

	if (k_msgq_put(&cmd_q, cmd, K_NO_WAIT) != 0) {
		printk("# WARN: command queue full, dropped '%s'\n", cmd);
	}

	return len;
}

BT_GATT_SERVICE_DEFINE(imu_svc,
	BT_GATT_PRIMARY_SERVICE(&uuid_svc),
	BT_GATT_CHARACTERISTIC(&uuid_rx.uuid,
			       BT_GATT_CHRC_WRITE | BT_GATT_CHRC_WRITE_WITHOUT_RESP,
			       BT_GATT_PERM_WRITE, NULL, on_rx_write, NULL),
	BT_GATT_CHARACTERISTIC(&uuid_tx.uuid, BT_GATT_CHRC_NOTIFY,
			       BT_GATT_PERM_NONE, NULL, NULL, NULL),
	BT_GATT_CCC(ccc_changed, BT_GATT_PERM_READ | BT_GATT_PERM_WRITE),
);

static const struct bt_data ad[] = {
	BT_DATA_BYTES(BT_DATA_FLAGS, (BT_LE_AD_GENERAL | BT_LE_AD_NO_BREDR)),
	BT_DATA(BT_DATA_NAME_COMPLETE, CONFIG_BT_DEVICE_NAME,
		sizeof(CONFIG_BT_DEVICE_NAME) - 1),
};

static const struct bt_data sd[] = {
	BT_DATA_BYTES(BT_DATA_UUID128_ALL, BT_UUID_IMU_SVC_VAL),
};

/* BT_LE_ADV_CONN was removed in Zephyr 4.x; spell the parameters out. */
static const struct bt_le_adv_param adv_param = BT_LE_ADV_PARAM_INIT(
	BT_LE_ADV_OPT_CONN,
	BT_GAP_ADV_FAST_INT_MIN_2,
	BT_GAP_ADV_FAST_INT_MAX_2,
	NULL);

static void start_advertising(void)
{
	int err = bt_le_adv_start(&adv_param, ad, ARRAY_SIZE(ad), sd, ARRAY_SIZE(sd));

	if (err) {
		printk("# ERR: advertising failed (%d)\n", err);
	} else {
		printk("# advertising as \"%s\"\n", CONFIG_BT_DEVICE_NAME);
	}
}

static void connected(struct bt_conn *conn, uint8_t err)
{
	if (err) {
		printk("# ERR: connection failed 0x%02x\n", err);
		return;
	}

	current_conn = bt_conn_ref(conn);
	printk("# BLE connected\n");
}

static void disconnected(struct bt_conn *conn, uint8_t reason)
{
	ARG_UNUSED(conn);
	printk("# BLE disconnected (0x%02x)\n", reason);

	subscribed = false;
	streaming = false;
	if (current_conn) {
		bt_conn_unref(current_conn);
		current_conn = NULL;
	}
	k_sem_give(&adv_restart_sem);
}

static void recycled(void)
{
	k_sem_give(&adv_restart_sem);
}

BT_CONN_CB_DEFINE(conn_callbacks) = {
	.connected = connected,
	.disconnected = disconnected,
	.recycled = recycled,
};

/* ---------------------------------------------------------------- public */

bool ble_stream_connected(void) { return current_conn != NULL; }
bool ble_stream_subscribed(void) { return subscribed; }
bool ble_stream_streaming(void) { return streaming; }
void ble_stream_set_streaming(bool on) { streaming = on; }

uint32_t ble_stream_dropped(void)
{
	return drop_count;
}

uint16_t ble_stream_ring_used(void)
{
	uint32_t used;

	k_mutex_lock(&ring_lock, K_FOREVER);
	used = ring_head - ring_tail;
	k_mutex_unlock(&ring_lock);

	return (uint16_t)MIN(used, UINT16_MAX);
}

void ble_stream_push(const struct imu_sample *s)
{
	k_mutex_lock(&ring_lock, K_FOREVER);

	if ((ring_head - ring_tail) >= RING_SAMPLES) {
		/* Full: drop this sample rather than the oldest one, so the region
		 * the sender is about to transmit is never overwritten. */
		drop_count++;
		k_mutex_unlock(&ring_lock);
		return;
	}

	ring[ring_head % RING_SAMPLES] = *s;
	ring_head++;
	k_mutex_unlock(&ring_lock);
}

bool ble_stream_pop_command(char *out, size_t len)
{
	if (len < CMD_MAX) {
		return false;
	}
	return k_msgq_get(&cmd_q, out, K_NO_WAIT) == 0;
}

/* --------------------------------------------------------- sender thread */

static void ble_sender(void *a, void *b, void *c)
{
	ARG_UNUSED(a);
	ARG_UNUSED(b);
	ARG_UNUSED(c);

	static uint8_t buf[512];
	static uint16_t seq;
	static uint32_t last_send_us;

	while (1) {
		if (k_sem_take(&adv_restart_sem, K_NO_WAIT) == 0) {
			k_msleep(200);
			start_advertising();
		}

		if (!current_conn || !subscribed || !streaming) {
			k_sleep(K_MSEC(20));
			continue;
		}

		uint16_t mtu = bt_gatt_get_mtu(current_conn);
		size_t payload = (mtu > 3) ? (mtu - 3) : 0;

		if (payload <= BLE_FRAME_HDR + BLE_SAMPLE_SIZE) {
			k_sleep(K_MSEC(20));
			continue;
		}

		size_t max_samples = (payload - BLE_FRAME_HDR) / BLE_SAMPLE_SIZE;
		uint32_t avail;
		size_t take;

		k_mutex_lock(&ring_lock, K_FOREVER);
		avail = ring_head - ring_tail;
		take = MIN(avail, max_samples);

		if (take == 0) {
			k_mutex_unlock(&ring_lock);
			k_sleep(K_MSEC(2));
			continue;
		}

		uint16_t dropped_now = (uint16_t)MIN(drop_count, UINT16_MAX);

		/* Batch instead of firing one notification per sample. A connection
		 * event can only carry a couple of packets, so at 200 Hz and above
		 * one-sample packets cannot keep up. Wait for either a second sample
		 * or a few milliseconds, whichever comes first. */
		uint32_t now_us = k_cyc_to_us_floor32(k_cycle_get_32());

		if (take < 2 && (now_us - last_send_us) < BATCH_WAIT_US) {
			k_mutex_unlock(&ring_lock);
			k_sleep(K_MSEC(1));
			continue;
		}

		buf[0] = BLE_FRAME_SAMPLES;
		buf[1] = (uint8_t)(seq & 0xFF);
		buf[2] = (uint8_t)(seq >> 8);
		buf[3] = (uint8_t)(dropped_now & 0xFF);
		buf[4] = (uint8_t)(dropped_now >> 8);
		buf[5] = (uint8_t)take;

		size_t off = BLE_FRAME_HDR;

		for (size_t i = 0; i < take; i++) {
			const struct imu_sample *s = &ring[(ring_tail + i) % RING_SAMPLES];

			buf[off + 0] = (uint8_t)(s->t_us);
			buf[off + 1] = (uint8_t)(s->t_us >> 8);
			buf[off + 2] = (uint8_t)(s->t_us >> 16);
			buf[off + 3] = (uint8_t)(s->t_us >> 24);
			for (int k = 0; k < 3; k++) {
				buf[off + 4 + 2 * k] = (uint8_t)(s->a[k]);
				buf[off + 5 + 2 * k] = (uint8_t)((uint16_t)s->a[k] >> 8);
			}
			for (int k = 0; k < 3; k++) {
				buf[off + 10 + 2 * k] = (uint8_t)(s->g[k]);
				buf[off + 11 + 2 * k] = (uint8_t)((uint16_t)s->g[k] >> 8);
			}
			off += BLE_SAMPLE_SIZE;
		}

		k_mutex_unlock(&ring_lock);

		int err = bt_gatt_notify(NULL, &imu_svc.attrs[TX_ATTR_INDEX], buf, off);

		if (err == 0) {
			k_mutex_lock(&ring_lock, K_FOREVER);
			ring_tail += take;
			k_mutex_unlock(&ring_lock);
			seq++;
			last_send_us = k_cyc_to_us_floor32(k_cycle_get_32());
		} else {
			/* Controller buffers full - back off briefly and retry the same
			 * samples, they are still at the tail. */
			k_sleep(K_MSEC(3));
		}
	}
}

K_THREAD_DEFINE(ble_sender_tid, 2048, ble_sender, NULL, NULL, NULL, 5, 0, 0);

int ble_stream_start(void)
{
	int err = bt_enable(NULL);

	if (err) {
		printk("# ERR: bt_enable failed (%d)\n", err);
		return err;
	}
	printk("# BLE stack ready\n");
	start_advertising();
	return 0;
}
```

## src/ble_stream.h
```c
/*
 * BLE data pipe for the BMI270 collector.
 *
 * Uses the Nordic UART Service UUIDs so generic BLE tools (nRF Connect, bleak)
 * can discover it, but the payload is a compact binary framing rather than text:
 *
 *   frame:  [type u8][seq u16le][dropped u16le][n u8][sample...]
 *   sample: [t_us u32le][ax i16][ay i16][az i16][gx i16][gy i16][gz i16]
 *
 * Raw LSB values are sent, not mg/mdps: the host owns the unit conversion, so
 * nothing is lost or rounded on the device. t_us is the device uptime, which
 * gives every sample a timestamp that is immune to host scheduling jitter.
 *
 * Commands arrive as newline-terminated ASCII on the RX characteristic and are
 * queued for the main loop, so I2C work never happens in the Bluetooth context.
 */

#pragma once

#include <stdbool.h>
#include <stddef.h>
#include <stdint.h>

#define BLE_FRAME_SAMPLES 0x01
#define BLE_FRAME_STATUS  0x02

#define BLE_SAMPLE_SIZE   16
#define BLE_FRAME_HDR     6
#define BLE_CMD_MAX       48

struct imu_sample {
	uint32_t t_us;
	int16_t  a[3];
	int16_t  g[3];
};

/* Bring up the stack, register the service and start advertising. */
int ble_stream_start(void);

bool ble_stream_connected(void);
bool ble_stream_subscribed(void);

/* Queue one sample. Drops the oldest sample when the ring is full and counts it,
 * so the host can see exactly how many samples were lost. */
void ble_stream_push(const struct imu_sample *s);

/* Gate the data path (START / STOP from the host). */
void ble_stream_set_streaming(bool on);
bool ble_stream_streaming(void);

uint32_t ble_stream_dropped(void);
uint16_t ble_stream_ring_used(void);

/* Pop a pending command line, or NULL when the queue is empty. */
bool ble_stream_pop_command(char *out, size_t len);
```

## src/bmi270.c
```c
/*
 * BMI270 6-axis IMU driver - Zephyr I2C backend.
 */

#include "bmi270.h"

#include <string.h>

#include <zephyr/kernel.h>
#include <zephyr/sys/printk.h>

#include "bmi270_config_file.h"

/* ------------------------------------------------------------- registers */

#define REG_CHIP_ID       0x00
#define REG_ACC_X_LSB     0x0C  /* 12 bytes: acc xyz then gyr xyz, LSB first */
#define REG_INTERNAL_ST   0x21
#define REG_ACC_CONF      0x40
#define REG_ACC_RANGE     0x41
#define REG_GYR_CONF      0x42
#define REG_GYR_RANGE     0x43
#define REG_INT1_IO_CTRL  0x53
#define REG_INT_MAP_DATA  0x58
#define REG_INIT_CTRL     0x59
#define REG_INIT_ADDR_0   0x5B
#define REG_INIT_DATA     0x5E
#define REG_PWR_CONF      0x7C
#define REG_PWR_CTRL      0x7D
#define REG_CMD           0x7E

#define CMD_SOFT_RESET    0xB6
#define CHIP_ID_BMI270    0x24

/* ACC_CONF base: bit7 acc_filter_perf | bits6:4 acc_bwp(=2)  */
#define ACC_CONF_BASE     0xA0
/* GYR_CONF base: bit7 gyr_filter_perf | bit6 gyr_noise_perf | bits5:4 bwp(=2).
 * Without bit6 the gyro runs in power-optimised (noisier) mode. */
#define GYR_CONF_BASE     0xE0

#define ACC_RANGE_CODE    0x02  /* +-8 g   */
#define GYR_RANGE_CODE    0x02  /* +-500 dps */

/* ------------------------------------------------------------------ ODR */

struct odr_step {
	uint16_t hz;
	uint8_t code;
};

static const struct odr_step odr_table[] = {
	{  25, 0x06 }, {  50, 0x07 }, { 100, 0x08 }, { 200, 0x09 },
	{ 400, 0x0A }, { 800, 0x0B }, { 1600, 0x0C },
};

#define ODR_TABLE_LEN (sizeof(odr_table) / sizeof(odr_table[0]))

static uint8_t odr_code_for(uint16_t hz)
{
	for (size_t i = 0; i < ODR_TABLE_LEN; i++) {
		if (odr_table[i].hz >= hz) {
			return odr_table[i].code;
		}
	}
	return odr_table[ODR_TABLE_LEN - 1].code;
}

static uint16_t odr_hz_of(uint8_t code)
{
	for (size_t i = 0; i < ODR_TABLE_LEN; i++) {
		if (odr_table[i].code == code) {
			return odr_table[i].hz;
		}
	}
	return 0;
}

uint16_t bmi270_effective_odr(uint16_t hz)
{
	if (hz < 1) {
		hz = 1;
	}
	return odr_hz_of(odr_code_for(hz));
}

/* ------------------------------------------------------------------- I2C */

int bmi270_write_reg(const struct bmi270_cfg *cfg, uint8_t reg, uint8_t val)
{
	return i2c_reg_write_byte(cfg->i2c, cfg->addr, reg, val);
}

int bmi270_read_reg(const struct bmi270_cfg *cfg, uint8_t reg, uint8_t *val)
{
	return i2c_reg_read_byte(cfg->i2c, cfg->addr, reg, val);
}

/* nRF TWIM moves data with EasyDMA, and EasyDMA cannot read a buffer that lives
 * in flash. BMI270_CONFIG_FILE is `static const` (flash), so a direct burst write
 * from it fails with -ENOSPC. Copy each chunk into a RAM buffer first. */
static int write_block(const struct bmi270_cfg *cfg, uint8_t reg,
		       const uint8_t *data, size_t len)
{
	uint8_t buf[1 + 32];

	if (len > sizeof(buf) - 1) {
		return -EINVAL;
	}
	buf[0] = reg;
	memcpy(&buf[1], data, len);

	return i2c_write(cfg->i2c, buf, len + 1, cfg->addr);
}

static int read_block(const struct bmi270_cfg *cfg, uint8_t reg,
		      uint8_t *data, size_t len)
{
	return i2c_burst_read(cfg->i2c, cfg->addr, reg, data, len);
}

/* ------------------------------------------------------------------ init */

int bmi270_init(const struct bmi270_cfg *cfg)
{
	uint8_t id = 0;
	int ret;

	ret = bmi270_read_reg(cfg, REG_CHIP_ID, &id);
	if (ret < 0) {
		printk("# ERR: I2C read failed (%d) - check SDA/SCL/3V3/GND\n", ret);
		return ret;
	}
	if (id != CHIP_ID_BMI270) {
		printk("# ERR: chip id 0x%02X, expected 0x%02X (BMI270)\n",
		       id, CHIP_ID_BMI270);
		return -ENODEV;
	}
	printk("# chip id 0x%02X OK\n", id);

	/* 1. soft reset, then wait for the command register to clear */
	ret = bmi270_write_reg(cfg, REG_CMD, CMD_SOFT_RESET);
	if (ret < 0) {
		printk("# ERR: soft reset write failed (%d)\n", ret);
		return ret;
	}
	k_busy_wait(2000);

	bool reset_done = false;

	for (int i = 0; i < 20; i++) {
		uint8_t st = 0xFF;

		if (bmi270_read_reg(cfg, REG_CMD, &st) == 0 && st == 0x00) {
			reset_done = true;
			break;
		}
		k_msleep(1);
	}
	if (!reset_done) {
		printk("# ERR: soft reset did not complete\n");
		return -EIO;
	}

	/* 2. advanced power save off, config load off.
	 * Datasheet: wait >= 450 us after clearing adv_power_save before touching
	 * another register, otherwise the upload below fails intermittently. */
	bmi270_write_reg(cfg, REG_PWR_CONF, 0x00);
	k_busy_wait(500);
	bmi270_write_reg(cfg, REG_INIT_CTRL, 0x00);

	/* 3. upload the 8 KB configuration blob, 32 bytes at a time */
	for (uint16_t i = 0; i < BMI270_CONFIG_FILE_SIZE; i += 32) {
		uint8_t addr[2];

		addr[0] = (uint8_t)((i / 2) & 0x0F); /* bits 0..3 of word address */
		addr[1] = (uint8_t)((i / 2) >> 4);   /* bits 4..11                 */

		ret = write_block(cfg, REG_INIT_ADDR_0, addr, sizeof(addr));
		if (ret < 0) {
			printk("# ERR: init address write failed at %u (%d)\n", i, ret);
			return ret;
		}
		ret = write_block(cfg, REG_INIT_DATA, &BMI270_CONFIG_FILE[i], 32);
		if (ret < 0) {
			printk("# ERR: config upload failed at %u (%d)\n", i, ret);
			return ret;
		}
	}

	/* 4. enable load, then poll for the ASIC to finish initialising */
	ret = bmi270_write_reg(cfg, REG_INIT_CTRL, 0x01);
	if (ret < 0) {
		printk("# ERR: config load enable failed (%d)\n", ret);
		return ret;
	}

	k_msleep(20);
	uint8_t internal_status = 0;
	bool load_ok = false;

	for (int i = 0; i < 18; i++) {
		if (bmi270_read_reg(cfg, REG_INTERNAL_ST, &internal_status) == 0 &&
		    (internal_status & 0x0F) == 0x01) {
			load_ok = true;
			break;
		}
		k_msleep(10);
	}
	if (!load_ok) {
		printk("# ERR: config load failed, internal status 0x%02X\n",
		       internal_status);
		return -EIO;
	}
	printk("# config loaded, internal status ok\n");

	/* 5. full scale */
	bmi270_write_reg(cfg, REG_ACC_RANGE, ACC_RANGE_CODE);
	bmi270_write_reg(cfg, REG_GYR_RANGE, GYR_RANGE_CODE);

	/* 6. data-ready interrupt on INT1: push-pull, active high, output on */
	bmi270_write_reg(cfg, REG_INT1_IO_CTRL, 0x08 | 0x02);
	bmi270_write_reg(cfg, REG_INT_MAP_DATA, 0x04);

	/* 7. enable accel + gyro */
	ret = bmi270_write_reg(cfg, REG_PWR_CTRL, 0x04 | 0x02);
	if (ret < 0) {
		printk("# ERR: power ctrl write failed (%d)\n", ret);
		return ret;
	}

	k_msleep(50);
	return 0;
}

int bmi270_set_rate(const struct bmi270_cfg *cfg, uint16_t hz)
{
	if (hz < 1) {
		hz = 1;
	}
	if (hz > 1600) {
		hz = 1600;
	}

	uint8_t code = odr_code_for(hz);
	int ret = bmi270_write_reg(cfg, REG_ACC_CONF, ACC_CONF_BASE | code);

	if (ret < 0) {
		return ret;
	}
	return bmi270_write_reg(cfg, REG_GYR_CONF, GYR_CONF_BASE | code);
}

int bmi270_read_sample(const struct bmi270_cfg *cfg, int16_t out[6])
{
	uint8_t b[12];
	int ret = read_block(cfg, REG_ACC_X_LSB, b, sizeof(b));

	if (ret < 0) {
		return ret;
	}
	for (int i = 0; i < 6; i++) {
		out[i] = (int16_t)((uint16_t)b[2 * i] | ((uint16_t)b[2 * i + 1] << 8));
	}
	return 0;
}

void bmi270_scan(const struct bmi270_cfg *cfg)
{
	int found = 0;

	printk("# scanning I2C ...\n");
	for (uint8_t a = 0x08; a < 0x78; a++) {
		uint8_t dummy;

		if (i2c_reg_read_byte(cfg->i2c, a, REG_CHIP_ID, &dummy) == 0) {
			printk("#   device at 0x%02X%s\n", a,
			       (a == cfg->addr) ? "  <- expected BMI270" : "");
			found++;
		}
	}
	if (found == 0) {
		printk("#   nothing responded - check pull-ups, pins and sensor power\n");
	} else {
		printk("# %d device(s) found\n", found);
	}
}
```

## src/bmi270.h
```c
/*
 * BMI270 6-axis IMU driver - Zephyr I2C backend.
 *
 * The register sequences, the 8 KB configuration blob and the ODR table are the
 * same as the ESP32 version of this firmware; only the I2C calls changed.
 */

#pragma once

#include <stdint.h>
#include <zephyr/device.h>
#include <zephyr/drivers/i2c.h>

#define BMI270_ADDR_DEFAULT 0x68

struct bmi270_cfg {
	const struct device *i2c;
	uint16_t addr;
};

/* Chip id check, soft reset and the 8 KB config upload. */
int bmi270_init(const struct bmi270_cfg *cfg);

/* Pick the lowest ODR >= hz and program ACC_CONF / GYR_CONF. */
int bmi270_set_rate(const struct bmi270_cfg *cfg, uint16_t hz);

/* Read accel xyz + gyro xyz, raw 16-bit LSB. */
int bmi270_read_sample(const struct bmi270_cfg *cfg, int16_t out[6]);

/* Raw register access, for the status / scan commands. */
int bmi270_read_reg(const struct bmi270_cfg *cfg, uint8_t reg, uint8_t *val);
int bmi270_write_reg(const struct bmi270_cfg *cfg, uint8_t reg, uint8_t val);

/* Probe every address on the bus and print what answers. */
void bmi270_scan(const struct bmi270_cfg *cfg);

/* The ODR actually programmed for a requested rate. */
uint16_t bmi270_effective_odr(uint16_t hz);
```
